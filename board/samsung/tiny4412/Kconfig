## board/samsung/tiny4412/Kconfig
```kconfig
if TARGET_TINY4412

config SYS_BOARD
	default "tiny4412"

config SYS_VENDOR
	default "samsung"

config SYS_CONFIG_NAME
	default "tiny4412"

config EXYNOS4412
	bool

endif
```

## configs/tiny4412_defconfig
```kconfig
CONFIG_ARM=y
CONFIG_ARCH_EXYNOS=y
CONFIG_ARCH_EXYNOS4=y
CONFIG_TARGET_TINY4412=y
CONFIG_DEFAULT_DEVICE_TREE="exynos4412-tiny4412"
CONFIG_SPL=y
# CONFIG_SYS_MALLOC_CLEAR_ON_INIT is not set
#CONFIG_FIT is not set
#CONFIG_FIT_VERBOSE is not set
CONFIG_SYS_CONSOLE_IS_IN_ENV=y
CONFIG_SYS_CONSOLE_INFO_QUIET=y
CONFIG_HUSH_PARSER=y
CONFIG_SYS_PROMPT="Tiny4412 # "
CONFIG_CMD_BOOTZ=y
# CONFIG_CMD_IMLS is not set
# CONFIG_CMD_XIMG is not set
CONFIG_DM_MMC=y
CONFIG_CMD_MMC=y
#CONFIG_CMD_I2C is not set
#CONFIG_CMD_USB is not set
#CONFIG_CMD_DFU is not set
#CONFIG_CMD_USB_MASS_STORAGE is not set
# CONFIG_CMD_FPGA is not set
#CONFIG_CMD_GPIO is not set
#CONFIG_CMD_DHCP is not set
# CONFIG_CMD_NFS is not set
#CONFIG_CMD_MII is not set
#CONFIG_CMD_PING is not set
#CONFIG_CMD_CACHE is not set
# CONFIG_CMD_MISC is not set
#CONFIG_CMD_PMIC is not set
#CONFIG_CMD_REGULATOR is not set
CONFIG_CMD_EXT2=y
CONFIG_CMD_EXT4=y
CONFIG_CMD_EXT4_WRITE=y
CONFIG_CMD_FAT=y
CONFIG_CMD_FS_GENERIC=y
CONFIG_OF_CONTROL=y
#CONFIG_DFU_MMC is not set
#CONFIG_DM_I2C is not set
#CONFIG_DM_I2C_COMPAT is not set
#CONFIG_DM_PMIC is not set
#CONFIG_DM_PMIC_MAX77686 is not set
#CONFIG_DM_REGULATOR is not set
#CONFIG_DM_REGULATOR_MAX77686 is not set
#CONFIG_USB is not set
#CONFIG_DM_USB is not set
#CONFIG_USB_STORAGE is not set
#CONFIG_USB_GADGET is not set
#CONFIG_USB_GADGET_DWC2_OTG is not set
#CONFIG_USB_GADGET_DOWNLOAD is not set
#CONFIG_G_DNL_MANUFACTURER="Samsung"
#CONFIG_G_DNL_VENDOR_NUM=0x04e8
#CONFIG_G_DNL_PRODUCT_NUM=0x6601
#CONFIG_ERRNO_STR is not set
CONFIG_IDENT_STRING=" for TINY4412"

#
#DEBUG UART
#
#CONFIG_DEBUG_UART is not set
#CONFIG_SPL_SERIAL_SUPPORT is not set
#CONFIG_SPL_GPIO_SUPPORT is not set
#CONFIG_DEBUG_UART_S5P is not set
#CONFIG_DEBUG_UART_BASE=0x13800000
#CONFIG_DEBUG_UART_CLOCK=100000000
```

## drivers/usb/eth/Kconfig
```kconfig
#
# USB ETHERNET Drivers
#
comment "USB ETHERNET Drivers"

config USB_ETHER_DM9601
	bool "DM9601 device driver"
	help
	  Say Y or if your system has a DM9601 device.
```
